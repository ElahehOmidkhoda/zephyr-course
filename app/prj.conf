## CMakeLists.txt
```
cmake_minimum_required(VERSION 3.20.0)

# Custom board definitions
# list(APPEND BOARD_ROOT ${CMAKE_CURRENT_SOURCE_DIR}/..)

# Custom Devicetree bindings
list(APPEND DTS_ROOT ${CMAKE_CURRENT_SOURCE_DIR}/..)

find_package(Zephyr REQUIRED HINTS $ENV{ZEPHYR_BASE})

project(my_zephyr_app)

target_sources(app PRIVATE src/main.cpp)

target_include_directories(app PRIVATE
    ${CMAKE_CURRENT_SOURCE_DIR}/../drivers/our_driver
)

add_subdirectory(
    ${CMAKE_CURRENT_SOURCE_DIR}/../drivers/our_driver
    ${CMAKE_CURRENT_BINARY_DIR}/our_driver
)
```

## Kconfig
```
config APP_HEARTBEAT_PERIOD_MS
    int "led blink period (ms)"
    default 500
    range 100 2000
    help
        Set the sleep time for the blink application in milliseconds.
    

source "Kconfig.zephyr"
rsource "../drivers/our_driver/Kconfig"
```

## prj.conf
```kconfig
CONFIG_GPIO=y
CONFIG_LOG=y
CONFIG_OUR_DRIVER=y
CONFIG_SHELL=y
CONFIG_SHELL_BACKEND_SERIAL=y
CONFIG_SERIAL=y
CONFIG_CONSOLE=y
CONFIG_SHELL_VT100_COLORS=n
CONFIG_SHELL_VT100_COMMANDS=n
```

## app.overlay
```dts
/ {
    our_driver0: our_driver {
        compatible = "our,driver";
        led-gpios = <&gpio0 26 GPIO_ACTIVE_LOW>;
        status = "okay";
    };
};
```

## src/main.cpp
```c
#include <zephyr/kernel.h>
#include <zephyr/device.h>
#include <zephyr/drivers/sensor.h>
#include <zephyr/logging/log.h>
//#include "our_driver.h"

//LOG_MODULE_REGISTER(main_app, LOG_LEVEL_INF);

//#define MY_SENSOR_NODE DT_NODELABEL(our_driver0)

int main(void)
{
   /*  const struct device *driver =
        DEVICE_DT_GET(MY_SENSOR_NODE);

    if (!device_is_ready(driver)) {
        LOG_ERR("Driver not ready");
        return 0;
    }

    our_driver_set_delay(driver, 500);
    LOG_INF("Custom extension API called successfully");

    struct sensor_value val = {}; */

    while (true) {
/* 
        // Turn LED ON
        int ret = sensor_sample_fetch(driver);

        if (ret < 0) {
            LOG_ERR("Sample fetch failed: %d", ret);
        }

        k_msleep(1000);

        // Turn LED OFF
        ret = sensor_channel_get(
            driver,
            SENSOR_CHAN_AMBIENT_TEMP,
            &val
        );

        if (ret < 0) {
            LOG_ERR("Channel get failed: %d", ret);
        }

        k_msleep(1000);
        
 */
    k_sleep(K_SECONDS(1));
    }

    return 0;
}
```
