## boards/nrf52840_scratch/Kconfig.defconfig
```kconfig
if BOARD_NRF52840_SCRATCH

source "boards/common/usb/Kconfig.cdc_acm_serial.defconfig"

endif # BOARD_NRF52840_SCRATCH
```

## boards/nrf52840_scratch/board.yml
```yaml
board:
  name: nrf52840_scratch
  full_name: NRF52840 XIAO BLE SCRATCH
  vendor: payatek
  socs:
  - name: nrf52840
```

## boards/nrf52840_xiao/Kconfig.defconfig
```kconfig
# XIAO BLE board configuration

# Copyright (c) 2022 Marcin Niestroj
# SPDX-License-Identifier: Apache-2.0

if BOARD_NRF52840_XIAO

source "boards/common/usb/Kconfig.cdc_acm_serial.defconfig"

endif # BOARD_NRF52840_XIAO
```

## boards/nrf52840_xiao/Kconfig.nrf52840_xiao
```kconfig
# XIAO BLE board configuration

# Copyright (c) 2022 Marcin Niestroj
# SPDX-License-Identifier: Apache-2.0

config BOARD_NRF52840_XIAO
	select SOC_NRF52840_QIAA
```

## boards/nrf52840_xiao/board.yml
```yaml
board:
  name: nrf52840_xiao
  full_name: NRF52840 XIAO BLE
  vendor: payatek
  socs:
  - name: nrf52840
    variants:
    - name: 'sense'
```

## dts/bindings/our,driver.yaml
```yaml
description: Our LED Sensor Driver

compatible: "our,driver"

include: base.yaml

properties:
  led-gpios:
    type: phandle-array
    required: true
    description: GPIO connected to LED
```

## west.yml
```yaml
manifest:
  version: 1.0

  projects:
    - name: zephyr
      url: https://github.com/zephyrproject-rtos/zephyr
      revision: v4.4.2
      import:
        path-prefix: deps
```
